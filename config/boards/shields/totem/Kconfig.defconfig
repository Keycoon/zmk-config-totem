## config/boards/shields/totem/Kconfig.defconfig
```kconfig
if SHIELD_TOTEM_LEFT

config ZMK_KEYBOARD_NAME
    default "TOTEM"
    
config ZMK_SPLIT_ROLE_CENTRAL
    default y

config ZMK_BLE_EXPERIMENTAL_CONN
    default y

config ZMK_BLE_KEYBOARD_REPORT_QUEUE_SIZE
    default 40

config ZMK_BLE_CONSUMER_REPORT_QUEUE_SIZE
    default 10

config ZMK_SPLIT_BLE_CENTRAL_POSITION_QUEUE_SIZE
    default 20

endif

if SHIELD_TOTEM_RIGHT

config ZMK_SPLIT_BLE_PERIPHERAL_POSITION_QUEUE_SIZE
    default 30

endif

if SHIELD_TOTEM_LEFT || SHIELD_TOTEM_RIGHT

config ZMK_SPLIT
    default y

endif
```
